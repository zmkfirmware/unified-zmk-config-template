## boards/shields/Modey/Kconfig.defconfig
```kconfig
if SHIELD_MOD_R

config ZMK_KEYBOARD_NAME
    default "mod_v3_R"

config ZMK_SPLIT
    default y

config ZMK_SPLIT_ROLE_CENTRAL
    default y

endif

if SHIELD_MOD_L

config ZMK_KEYBOARD_NAME
    default "mod_v3_L"

config ZMK_SPLIT
    default y

endif
```

## config/west.yml
```yaml
manifest:
  defaults:
    revision: v0.2
  remotes:
    - name: zmkfirmware
      url-base: https://github.com/zmkfirmware
    # Additional modules containing boards/shields/custom code can be listed here as well
    # See https://docs.zephyrproject.org/3.2.0/develop/west/manifest.html#projects
  projects:
    - name: zmk
      remote: zmkfirmware
      import: app/west.yml
  self:
    path: config
```
